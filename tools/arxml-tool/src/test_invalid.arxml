AUTOSAR XML (schema 4.0)
package /TestPackage
  elements p-port-prototype=provided-interface=Interface:
    application sw component type CompA
    application sw component type CompB
    component InvalidRefComp: type=Component
    assembly sw connector IncompleteConnector: requester=testComp.testPort
    application sw component type OrphanedComponent
