AUTOSAR XML (schema 4.0)
ar-packages ar-package="Package without short name":
package /TestPackage
  application sw component type ComponentA
    provide port PortA_P: provided-interface=Interface
  application sw component type ComponentB
  ecu configuration TestECU: ecu=TestECU_01
  application sw component type UnmappedComponent
    require port PortB_R: required-interface=NonExistent_IF
  application sw component type 123InvalidName  # Name starting with number
  composition sw component type TestComposition
    component InstanceA: type=ComponentA
    assembly sw connector IncompleteConnection: provider=InstanceA.PortA_P
  sender receiver interface TestInterface
    data CustomData: type=CustomType123
  system mapping TestMapping
    swc to ecu mapping IncompleteMapping: component=ComponentA
