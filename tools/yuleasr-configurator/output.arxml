AUTOSAR XML (schema 4.0)
ecu-extractors:
  92 x ecuc value:
    Mcu
      Mcu (): VERSION=1.0.0, RAM-SECTORS=1, MODES=3, RESET-REASONS=8, CORE-COUNT=4
        GENERAL (): DEV-ERROR-DETECT=TRUE, VERSION-INFO-API=TRUE, NO-PLL=FALSE, INIT-CLOCK=TRUE, GET-RAM-STATE-API=FALSE
        CLOCK (): XTAL-FREQUENCY-HZ=24000000, SYSTEM-FREQUENCY-HZ=800000000, BUS-FREQUENCY-HZ=200000000, FLASH-FREQUENCY-HZ=40000000, NUM-CONFIGS=1, DEFAULT-SETTING=0
    Can
      Can (): VERSION=1.0.0, CONTROLLERS=2, HOH=8, HW-OBJECTS=16, BAUDRATE=500000
        GENERAL (): DEV-ERROR-DETECT=TRUE, VERSION-INFO-API=TRUE, MULTIPLEXED-TRANSMISSION=FALSE, HW-TRANSMIT-CANCELLATION=FALSE, FIFO-ENABLE=TRUE, WAKEUP-SUPPORT=TRUE
    Port
      Port (): VERSION=1.0.0, PINS=32, PORTS=5
        GENERAL (): DEV-ERROR-DETECT=TRUE, VERSION-INFO-API=TRUE, SET-PIN-DIRECTION-API=TRUE, SET-PIN-MODE-API=TRUE
    Spi
      Spi (): VERSION=1.0.0, CHANNELS=4, JOBS=8, SEQUENCES=4, HW-UNITS=3
        GENERAL (): DEV-ERROR-DETECT=TRUE, VERSION-INFO-API=TRUE, INTERRUPTIBLE-SEQ-ALLOWED=FALSE, HW-STATUS-API=TRUE, CANCEL-API=FALSE, LEVEL-DELIVERED=2
    Gpt
      Gpt (): VERSION=1.0.0, MAX-TICK-VALUE=0xFFFFFFFFU
        GENERAL ():
          DEV-ERROR-DETECT = TRUE
          VERSION-INFO-API = TRUE
          WAKEUP-FUNCTIONALITY-API = FALSE
          DEINIT-API = TRUE
          TIME-ELAPSED-API = TRUE
          TIME-REMAINING-API = TRUE
          ENABLE-DISABLE-NOTIFICATION-API = TRUE
    CanIf
      CanIf (): VERSION=1.0.0, CONTROLLERS=2, HRH=4, HTH=4, TX-PDUS=16, RX-PDUS=16, DEFAULT-BAUDRATE=500000, DEFAULT-BAUDRATE-CONFIG=0
        GENERAL ():
          DEV-ERROR-DETECT = TRUE
          VERSION-INFO-API = TRUE
          DLC-CHECK = TRUE
          SOFTWARE-FILTER = TRUE
          READRXPDU-DATA-API = TRUE
          READTXPDU-NOTIFY-STATUS-API = FALSE
          READRXPDU-NOTIFY-STATUS-API = FALSE
    IoHwAb
      IoHwAb (): VERSION=1.0.0
        4 x :
          GENERAL: DEV-ERROR-DETECT=TRUE, VERSION-INFO-API=TRUE
          CHANNELS: ANALOG-INPUTS=16, ANALOG-OUTPUTS=8, DIGITAL-INPUTS=32, DIGITAL-OUTPUTS=32, PWM-OUTPUTS=8, ICU-INPUTS=4, OPAMP-CHANNELS=2
          ADC: RESOLUTION=12, MAX-VALUE=4095, VREF-MV=3300
          PWM: MIN-FREQUENCY-HZ=1, MAX-FREQUENCY-HZ=20000, DEFAULT-FREQUENCY-HZ=1000
    Com
      Com (): VERSION=1.0.0, SIGNALS=64, GROUP-SIGNALS=16, IPDUS=32, IPDU-GROUPS=4, MAX-IPDU-BUFFER-SIZE=64, NUM-SIGNAL-GW-MAPPINGS=8
        GENERAL (): DEV-ERROR-DETECT=TRUE, VERSION-INFO-API=TRUE, ENABLE-MDT-FOR-CYCLIC-TRANSMISSION=TRUE, RETRY-FAILED-TRANSMIT-REQUESTS=TRUE, GATEWAY-SUPPORT=TRUE
        TIMING (): MAIN-FUNCTION-PERIOD-MS=10, MAIN-FUNCTION-RX-PERIOD-MS=10, MAIN-FUNCTION-TX-PERIOD-MS=10, FIRST-TIMEOUT-FACTOR=10, TIMEOUT-FACTOR=100
    PduR
      PduR (): VERSION=1.0.0, ROUTING-PATHS=16, ROUTING-PATH-GROUPS=4, MAX-DESTINATIONS-PER-PATH=4, FIFO-DEPTH=8, MAIN-FUNCTION-PERIOD-MS=10
        GENERAL (): DEV-ERROR-DETECT=TRUE, VERSION-INFO-API=TRUE, GATEWAY-OPERATION-ENABLED=TRUE
    NvM
      NvM ():
        VERSION = 1.0.0
        NVRAM-BLOCKS = 32
        DATASETS = 8
        ROM-BLOCKS = 16
        MAX-WRITE-RETRIES = 3
        MAX-READ-RETRIES = 3
        MAIN-FUNCTION-PERIOD-MS = 10
        STANDARD-JOB-QUEUE-SIZE = 16
        IMMEDIATE-JOB-QUEUE-SIZE = 4
        GENERAL ():
          DEV-ERROR-DETECT = TRUE
          VERSION-INFO-API = TRUE
          SET-RAM-BLOCK-STATUS-API = TRUE
          GET-ERROR-STATUS-API = TRUE
          SET-BLOCK-PROTECTION-API = TRUE
          GET-BLOCK-PROTECTION-API = FALSE
          SET-DATA-INDEX-API = TRUE
          GET-DATA-INDEX-API = FALSE
          CANCEL-JOB-API = TRUE
          KILL-WRITE-ALL-API = FALSE
          KILL-READ-ALL-API = FALSE
          REPAIR-DAMAGED-BLOCKS-API = FALSE
          CALC-RAM-BLOCK-CRC = TRUE
          USE-CRC-COMP-MECHANISM = TRUE
          MULTI-BLOCK-CALLBACK = FALSE
    BswM
      BswM (): VERSION=1.0.0
        GENERAL (): DEV-ERROR-DETECT=TRUE, VERSION-INFO-API=TRUE
        LIMITS (): MAX-MODE-REQUEST-PORTS=32, MAX-EXPRESSIONS=128, MAX-RULES=64, MAX-ACTIONS=128, MAX-ACTION-LISTS=32
    CanTp
      CanTp (): VERSION=1.0.0
        5 x :
          GENERAL: DEV-ERROR-DETECT=TRUE, VERSION-INFO-API=TRUE, DYNAMIC-CHANNEL-ALLOCATION=FALSE, CANFD-ENABLED=FALSE, PADDING-BYTE=TRUE, PADDING-BYTE-VALUE=204, CHANGE-PARAMETER-API=TRUE, READ-PARAMETER-API=TRUE, ADDRESSING-FORMAT=CANTP_STANDARD
          TIMING: MAIN-FUNCTION-PERIOD-MS=5, NAS-MS=25, NBS-MS=75, NCS-MS=25, NAR-MS=25, NBR-MS=75, NCR-MS=150, BS-DEFAULT=8, STMIN-DEFAULT=20, WFT-MAX-DEFAULT=8
          LIMITS: MAX-CHANNEL-CNT=4, MAX-MESSAGE-LENGTH=4095, CANFD-MAX-MESSAGE-LENGTH=4095, CHANNEL-BUFFER-SIZE=64, CAN-FRAME-LENGTH=8, INVALID-CHANNEL-ID=255
          ADDRESSES: TX=0, RX=0
          CANIF-PDU-IDS: TX=0, RX=0, FC-TX=1, FC-RX=1
    Dcm
      Dcm (): VERSION=1.0.0
        5 x :
          GENERAL: DEV-ERROR-DETECT=TRUE, VERSION-INFO-API=TRUE, RESPOND-ALL-REQUEST=TRUE, TASK-TIME=TRUE, OBD-SUPPORT=TRUE, ROUTINE-CONTROL-SUPPORT=TRUE, DATA-TRANSFER-SUPPORT=TRUE
          COUNTS: PROTOCOLS=2, CONNECTIONS=4, RX-PDU-IDS=4, TX-PDU-IDS=4, SESSIONS=4, SECURITY-LEVELS=3, SERVICES=16, OBD-PIDS=32, ROUTINES=8, DIDS=32, RIDS=8
          BUFFERS: RX-BUFFER-SIZE=256, TX-BUFFER-SIZE=256, BUFFER-SIZE=4095, MAX-REQUEST-SIZE=4095, MAX-RESPONSE-SIZE=4095, TRANSFER-BLOCK-SIZE=1024, TRANSFER-MAX-BLOCK-SIZE=4096
          TIMING: MAIN-FUNCTION-PERIOD-MS=10, SESSION-DEFAULT-TIMEOUT-MS=5000, SESSION-PROGRAMMING-TIMEOUT-MS=5000, SESSION-EXTENDED-TIMEOUT-MS=5000, SESSION-SAFETY-TIMEOUT-MS=5000, P2-SERVER-MAX-MS=50, P2-STAR-SERVER-MAX-MS=5000, S3-SERVER-MS=5000
          SECURITY: MAX-ATTEMPTS=3, DELAY-TIME-MS=10000, SEED-SIZE=4, KEY-SIZE=4
    Dem
      Dem (): VERSION=1.0.0
        7 x :
          GENERAL: DEV-ERROR-DETECT=TRUE, VERSION-INFO-API=TRUE, CLEAR-DTC-SUPPORTED=TRUE, CLEAR-DTC-LIMITATION=FALSE, OBD-RELEVANT-SUPPORT=TRUE, J1939-SUPPORT=FALSE, DEBOUNCE-COUNTER-BASED=TRUE, DEBOUNCE-TIME-BASED=TRUE, DEBOUNCE-MONITOR-INTERNAL=TRUE
          COUNTS: EVENTS=128, DTCS=64, FREEZE-FRAME-RECORDS=8, EXTENDED-DATA-RECORDS=4, INDICATORS=8, OPERATION-CYCLES=5, ENABLE-CONDITIONS=8, STORAGE-CONDITIONS=8, OBD-PIDS=32, OBD-TIDS=16, OBD-INFOTYPES=8, J1939-FMI=32, J1939-OC=16
          DEBOUNCE: COUNTER-FAILED-THRESHOLD=127, COUNTER-PASSED-THRESHOLD=-128U, COUNTER-INCREMENT=1, COUNTER-DECREMENT=1, COUNTER-INCREMENT-STEP=1, COUNTER-DECREMENT-STEP=1, TIME-FAILED-THRESHOLD-MS=100, TIME-PASSED-THRESHOLD-MS=100, FDC-THRESHOLD=80, FDC-MAX=127, FDC-MIN=-128U
          TIMING: MAIN-FUNCTION-PERIOD-MS=10
          AGING: CYCLE-COUNTER-MAX=255, CYCLE-COUNTER-THRESHOLD=40, THRESHOLD=40
          LIMITS: MAX-OCCURRENCE-COUNTER=255, EVENT-ID-MIN=1, EVENT-ID-MAX=127, DTC-INVALID=0, DTC-MIN=1, DTC-MAX=16777215, DTC-PRIORITY-MIN=1, DTC-PRIORITY-MAX=255, FREEZE-FRAME-MAX-DIDS=16, FREEZE-FRAME-MAX-SIZE=256, EXTENDED-DATA-MAX-SIZE=128, DTC-STATUS-AVAILABILITY-MASK=255, DTC-GROUP-ALL=16777215
          MEMORY: PRIMARY-SIZE=4096, MIRROR-SIZE=2048, PERMANENT-SIZE=1024
    WdgM
      WdgM (): VERSION=1.0.0
        5 x :
          GENERAL: DEV-ERROR-DETECT=TRUE, VERSION-INFO-API=TRUE, VENDOR-ID=43, AR-RELEASE-MAJOR-VERSION=4, AR-RELEASE-MINOR-VERSION=7, AR-RELEASE-REVISION-VERSION=0, SW-MAJOR-VERSION=1, SW-MINOR-VERSION=0, SW-PATCH-VERSION=0
          WINDOW-WATCHDOG: ENABLED=TRUE, TRIGGER-PERIOD-MS=50, TIMEOUT-MS=100, WINDOW-START-PERCENT=50, WINDOW-END-PERCENT=100
          INDEPENDENT-WATCHDOG: ENABLED=TRUE, TRIGGER-PERIOD-MS=100, TIMEOUT-MS=200
          SUPERVISION: CYCLE-MS=10, FAILURE-THRESHOLD=3, MAX-SUPERVISED-ENTITIES=8
          INTEGRATIONS: LOCKSTEP=TRUE, RAMSAFETY=TRUE, DEM=TRUE
    SecOC
      SecOC (): VERSION=1.0.0
        6 x :
          GENERAL: DEV-ERROR-DETECT=TRUE, VERSION-INFO-API=TRUE, ENABLE-FRESHNESS-SYNC=TRUE, OVERRIDE-STATUS-ALLOWED=TRUE, AR-RELEASE-MAJOR-VERSION=4, AR-RELEASE-MINOR-VERSION=7, AR-RELEASE-REVISION-VERSION=0, SW-MAJOR-VERSION=1, SW-MINOR-VERSION=0, SW-PATCH-VERSION=0
          COUNTS: TX-PDUS=4, RX-PDUS=4, MAX-PDUS=4, MAX-CRYPTO-OPERATIONS=4, VERIFICATION-RETRY-COUNT=3
          TIMING: MAIN-FUNCTION-PERIOD-RX-MS=10, MAIN-FUNCTION-PERIOD-TX-MS=10, VERIFICATION-TIMEOUT-MS=100
          AUTHENTICATION: ALGORITHM-ALIAS=SECOC_HMAC_SHA256, AUTH-INFO-LENGTH=16, DATA-ID-LENGTH=1, CSM-JOB-ID-AUTH-ALIAS=CSM_JOB_ID_MAC_GENERATE_1, CSM-JOB-ID-VERIFY-ALIAS=CSM_JOB_ID_MAC_VERIFY_1
          FRESHNESS: VALUE-TYPE-ALIAS=SECOC_COUNTER, VALUE-TX-LENGTH=16, VALUE-LENGTH=32, MAX-FRESHNESS-VALUE=4294967295, RESET-THRESHOLD=4026531840, DEFAULT-VERIFICATION-STATUS-ALIAS=SECOC_UNVERIFIED
          LIMITS: MAX-PDU-LENGTH=256
    Os
      Os (): VERSION=1.0.0
        4 x :
          GENERAL: DEV-ERROR-DETECT=TRUE, USE-GET-SERVICE-ID=TRUE, USE-PARAMETER-ACCESS=TRUE, PROTECTION-HOOK=FALSE, STACK-MONITORING=TRUE, STARTUP-HOOK=TRUE, SHUTDOWN-HOOK=TRUE, ERROR-HOOK=TRUE, PRETASK-HOOK=FALSE, POSTTASK-HOOK=FALSE
          COUNTS: TASKS=8, ALARMS=6, RESOURCES=4, TASK-COUNT-RESERVED=8, RESOURCE-COUNT-RESERVED=0
          MAIN-COUNTER: TICKS-PER-MS=1, MAX-ALLOWED-VALUE=4294967295, MIN-CYCLE=1
          STACKS: TASK-STACK-SIZE=4096, ISR-STACK-SIZE=2048
    adc
      adc (): VERSION=1.0.0
        GENERAL (): DEV-ERROR-DETECT=TRUE, VERSION-INFO-API=TRUE
    canNm
      canNm (): VERSION=1.0.0
        GENERAL (): DEV-ERROR-DETECT=TRUE, VERSION-INFO-API=TRUE
    canm
      canm (): VERSION=1.0.0
        GENERAL (): DEV-ERROR-DETECT=TRUE, VERSION-INFO-API=TRUE
    cansm
      cansm (): VERSION=1.0.0
        GENERAL (): DEV-ERROR-DETECT=TRUE, VERSION-INFO-API=TRUE
    cantrcv
      cantrcv (): VERSION=1.0.0
        GENERAL (): DEV-ERROR-DETECT=TRUE, VERSION-INFO-API=TRUE
    cantsyn
      cantsyn (): VERSION=1.0.0
        GENERAL (): DEV-ERROR-DETECT=TRUE, VERSION-INFO-API=TRUE
    comM
      comM (): VERSION=1.0.0
        GENERAL (): DEV-ERROR-DETECT=TRUE, VERSION-INFO-API=TRUE
    crc
      crc (): VERSION=1.0.0
        GENERAL (): DEV-ERROR-DETECT=TRUE, VERSION-INFO-API=TRUE
    cryif
      cryif (): VERSION=1.0.0
        GENERAL (): DEV-ERROR-DETECT=TRUE, VERSION-INFO-API=TRUE
    crypto
      crypto (): VERSION=1.0.0
        GENERAL (): DEV-ERROR-DETECT=TRUE, VERSION-INFO-API=TRUE
    csm
      csm (): VERSION=1.0.0
        GENERAL (): DEV-ERROR-DETECT=TRUE, VERSION-INFO-API=TRUE
    det
      det (): VERSION=1.0.0
        GENERAL (): DEV-ERROR-DETECT=TRUE, VERSION-INFO-API=TRUE
    dio
      dio (): VERSION=1.0.0
        GENERAL (): DEV-ERROR-DETECT=TRUE, VERSION-INFO-API=TRUE
    dlt
      dlt (): VERSION=1.0.0
        GENERAL (): DEV-ERROR-DETECT=TRUE, VERSION-INFO-API=TRUE
    doIP
      doIP (): VERSION=1.0.0
        GENERAL (): DEV-ERROR-DETECT=TRUE, VERSION-INFO-API=TRUE
    docan
      docan (): VERSION=1.0.0
        GENERAL (): DEV-ERROR-DETECT=TRUE, VERSION-INFO-API=TRUE
    e2e
      e2e (): VERSION=1.0.0
        GENERAL (): DEV-ERROR-DETECT=TRUE, VERSION-INFO-API=TRUE
    ea
      ea (): VERSION=1.0.0
        GENERAL (): DEV-ERROR-DETECT=TRUE, VERSION-INFO-API=TRUE
    ecuC
      ecuC (): VERSION=1.0.0
        GENERAL (): DEV-ERROR-DETECT=TRUE, VERSION-INFO-API=TRUE
    ecum
      ecum (): VERSION=1.0.0
        GENERAL (): DEV-ERROR-DETECT=TRUE, VERSION-INFO-API=TRUE
    eep
      eep (): VERSION=1.0.0
        GENERAL (): DEV-ERROR-DETECT=TRUE, VERSION-INFO-API=TRUE
    eth
      eth (): VERSION=1.0.0
        GENERAL (): DEV-ERROR-DETECT=TRUE, VERSION-INFO-API=TRUE
    ethSm
      ethSm (): VERSION=1.0.0
        GENERAL (): DEV-ERROR-DETECT=TRUE, VERSION-INFO-API=TRUE
    ethif
      ethif (): VERSION=1.0.0
        GENERAL (): DEV-ERROR-DETECT=TRUE, VERSION-INFO-API=TRUE
    ethswt
      ethswt (): VERSION=1.0.0
        GENERAL (): DEV-ERROR-DETECT=TRUE, VERSION-INFO-API=TRUE
    ethtrcv
      ethtrcv (): VERSION=1.0.0
        GENERAL (): DEV-ERROR-DETECT=TRUE, VERSION-INFO-API=TRUE
    ethtsyn
      ethtsyn (): VERSION=1.0.0
        GENERAL (): DEV-ERROR-DETECT=TRUE, VERSION-INFO-API=TRUE
    fee
      fee (): VERSION=1.0.0
        GENERAL (): DEV-ERROR-DETECT=TRUE, VERSION-INFO-API=TRUE
    fim
      fim (): VERSION=1.0.0
        GENERAL (): DEV-ERROR-DETECT=TRUE, VERSION-INFO-API=TRUE
    flash
      flash (): VERSION=1.0.0
        GENERAL (): DEV-ERROR-DETECT=TRUE, VERSION-INFO-API=TRUE
    fls
      fls (): VERSION=1.0.0
        GENERAL (): DEV-ERROR-DETECT=TRUE, VERSION-INFO-API=TRUE
    flstst
      flstst (): VERSION=1.0.0
        GENERAL (): DEV-ERROR-DETECT=TRUE, VERSION-INFO-API=TRUE
    frif
      frif (): VERSION=1.0.0
        GENERAL (): DEV-ERROR-DETECT=TRUE, VERSION-INFO-API=TRUE
    frtp
      frtp (): VERSION=1.0.0
        GENERAL (): DEV-ERROR-DETECT=TRUE, VERSION-INFO-API=TRUE
    i2c
      i2c (): VERSION=1.0.0
        GENERAL (): DEV-ERROR-DETECT=TRUE, VERSION-INFO-API=TRUE
    icu
      icu (): VERSION=1.0.0
        GENERAL (): DEV-ERROR-DETECT=TRUE, VERSION-INFO-API=TRUE
    ipdum
      ipdum (): VERSION=1.0.0
        GENERAL (): DEV-ERROR-DETECT=TRUE, VERSION-INFO-API=TRUE
    j1939nm
      j1939nm (): VERSION=1.0.0
        GENERAL (): DEV-ERROR-DETECT=TRUE, VERSION-INFO-API=TRUE
    j1939tp
      j1939tp (): VERSION=1.0.0
        GENERAL (): DEV-ERROR-DETECT=TRUE, VERSION-INFO-API=TRUE
    keym
      keym (): VERSION=1.0.0
        GENERAL (): DEV-ERROR-DETECT=TRUE, VERSION-INFO-API=TRUE
    ldcom
      ldcom (): VERSION=1.0.0
        GENERAL (): DEV-ERROR-DETECT=TRUE, VERSION-INFO-API=TRUE
    lin
      lin (): VERSION=1.0.0
        GENERAL (): DEV-ERROR-DETECT=TRUE, VERSION-INFO-API=TRUE
    linNm
      linNm (): VERSION=1.0.0
        GENERAL (): DEV-ERROR-DETECT=TRUE, VERSION-INFO-API=TRUE
    linSM
      linSM (): VERSION=1.0.0
        GENERAL (): DEV-ERROR-DETECT=TRUE, VERSION-INFO-API=TRUE
    linTp
      linTp (): VERSION=1.0.0
        GENERAL (): DEV-ERROR-DETECT=TRUE, VERSION-INFO-API=TRUE
    linif
      linif (): VERSION=1.0.0
        GENERAL (): DEV-ERROR-DETECT=TRUE, VERSION-INFO-API=TRUE
    linm
      linm (): VERSION=1.0.0
        GENERAL (): DEV-ERROR-DETECT=TRUE, VERSION-INFO-API=TRUE
    lintrcv
      lintrcv (): VERSION=1.0.0
        GENERAL (): DEV-ERROR-DETECT=TRUE, VERSION-INFO-API=TRUE
    lntm
      lntm (): VERSION=1.0.0
        GENERAL (): DEV-ERROR-DETECT=TRUE, VERSION-INFO-API=TRUE
    mem
      mem (): VERSION=1.0.0
        GENERAL (): DEV-ERROR-DETECT=TRUE, VERSION-INFO-API=TRUE
    memif
      memif (): VERSION=1.0.0
        GENERAL (): DEV-ERROR-DETECT=TRUE, VERSION-INFO-API=TRUE
    mqtt
      mqtt (): VERSION=1.0.0
        GENERAL (): DEV-ERROR-DETECT=TRUE, VERSION-INFO-API=TRUE
    nm
      nm (): VERSION=1.0.0
        GENERAL (): DEV-ERROR-DETECT=TRUE, VERSION-INFO-API=TRUE
    ocu
      ocu (): VERSION=1.0.0
        GENERAL (): DEV-ERROR-DETECT=TRUE, VERSION-INFO-API=TRUE
    pwm
      pwm (): VERSION=1.0.0
        GENERAL (): DEV-ERROR-DETECT=TRUE, VERSION-INFO-API=TRUE
    ramsafety
      ramsafety (): VERSION=1.0.0
        GENERAL (): DEV-ERROR-DETECT=TRUE, VERSION-INFO-API=TRUE
    ramtst
      ramtst (): VERSION=1.0.0
        GENERAL (): DEV-ERROR-DETECT=TRUE, VERSION-INFO-API=TRUE
    schm
      schm (): VERSION=1.0.0
        GENERAL (): DEV-ERROR-DETECT=TRUE, VERSION-INFO-API=TRUE
    sd
      sd (): VERSION=1.0.0
        GENERAL (): DEV-ERROR-DETECT=TRUE, VERSION-INFO-API=TRUE
    soad
      soad (): VERSION=1.0.0
        GENERAL (): DEV-ERROR-DETECT=TRUE, VERSION-INFO-API=TRUE
    someip
      someip (): VERSION=1.0.0
        GENERAL (): DEV-ERROR-DETECT=TRUE, VERSION-INFO-API=TRUE
    someipif
      someipif (): VERSION=1.0.0
        GENERAL (): DEV-ERROR-DETECT=TRUE, VERSION-INFO-API=TRUE
    someipsd
      someipsd (): VERSION=1.0.0
        GENERAL (): DEV-ERROR-DETECT=TRUE, VERSION-INFO-API=TRUE
    someiptp
      someiptp (): VERSION=1.0.0
        GENERAL (): DEV-ERROR-DETECT=TRUE, VERSION-INFO-API=TRUE
    someipxf
      someipxf (): VERSION=1.0.0
        GENERAL (): DEV-ERROR-DETECT=TRUE, VERSION-INFO-API=TRUE
    srp
      srp (): VERSION=1.0.0
        GENERAL (): DEV-ERROR-DETECT=TRUE, VERSION-INFO-API=TRUE
    stbm
      stbm (): VERSION=1.0.0
        GENERAL (): DEV-ERROR-DETECT=TRUE, VERSION-INFO-API=TRUE
    swc
      swc (): VERSION=1.0.0
        GENERAL (): DEV-ERROR-DETECT=TRUE, VERSION-INFO-API=TRUE
    tcpip
      tcpip (): VERSION=1.0.0
        GENERAL (): DEV-ERROR-DETECT=TRUE, VERSION-INFO-API=TRUE
    tm
      tm (): VERSION=1.0.0
        GENERAL (): DEV-ERROR-DETECT=TRUE, VERSION-INFO-API=TRUE
    uart
      uart (): VERSION=1.0.0
        GENERAL (): DEV-ERROR-DETECT=TRUE, VERSION-INFO-API=TRUE
    udpNm
      udpNm (): VERSION=1.0.0
        GENERAL (): DEV-ERROR-DETECT=TRUE, VERSION-INFO-API=TRUE
    wdg
      wdg (): VERSION=1.0.0
        GENERAL (): DEV-ERROR-DETECT=TRUE, VERSION-INFO-API=TRUE
    wdgif
      wdgif (): VERSION=1.0.0
        GENERAL (): DEV-ERROR-DETECT=TRUE, VERSION-INFO-API=TRUE
    xcp
      xcp (): VERSION=1.0.0
        GENERAL (): DEV-ERROR-DETECT=TRUE, VERSION-INFO-API=TRUE
