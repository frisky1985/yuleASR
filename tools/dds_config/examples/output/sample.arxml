AUTOSAR XML (schema 4.0)
package /DDS_Configuration
  system ADAS_Sensor_Fusion
    ecu to dds domain mapping Domain_PerceptionDomain: dds-domain-id=1, dds-participant=CameraECU, dds-participant=RadarECU
    ecu to dds domain mapping Domain_ControlDomain: dds-domain-id=2, dds-participant=PlanningECU
  dds participant CameraECU: domain=PerceptionDomain
    publisher Pub_CameraObjectDetection: topic-name=CameraObjectDetection, type-name=ObjectDetectionData
    publisher Pub_CameraLaneDetection: topic-name=CameraLaneDetection, type-name=LaneData
    subscriber Sub_FusionResult: topic-name=FusionResult, type-name=FusionData
  dds participant RadarECU: domain=PerceptionDomain
    publisher Pub_RadarDetection: topic-name=RadarDetection, type-name=RadarData
  dds participant PlanningECU: domain=ControlDomain
    publisher Pub_VehicleCommand: topic-name=VehicleCommand, type-name=CommandData
    subscriber Sub_CameraObjectDetection: topic-name=CameraObjectDetection, type-name=ObjectDetectionData
    subscriber Sub_RadarDetection: topic-name=RadarDetection, type-name=RadarData
    subscriber Sub_FusionResult: topic-name=FusionResult, type-name=FusionData
  4 x dds qos profile:
    default: reliability=BEST_EFFORT
    reliable: reliability=RELIABLE, durability=TRANSIENT_LOCAL
    sensor_high_reliability: reliability=RELIABLE, durability=VOLATILE
    control_realtime: reliability=RELIABLE
