AUTOSAR XML (schema 4.0)
package /DDS_ADAS_Configuration
  dds domain participant config Domain1_PerceptionDomain: domain-id=1
    dds domain participant CameraECU:
      qos-profile=sensor_high_reliability
      dds-publisher={topic=CameraObjectDetection, data-type=ObjectDetectionData, dds-qos={reliability=RELIABLE, durability=VOLATILE, history=KEEP_LAST, history-depth=1, deadline={sec=0, nanosec=33000000}, liveliness=AUTOMATIC}}
      dds-publisher={topic=CameraImage, data-type=ImageData, dds-qos={reliability=BEST_EFFORT, durability=VOLATILE, history=KEEP_LAST, history-depth=2, liveliness=AUTOMATIC}}
    dds domain participant RadarECU: dds-publisher={topic=RadarData, data-type=RadarPointCloud, dds-qos={reliability=RELIABLE, durability=VOLATILE, history=KEEP_LAST, history-depth=1, deadline={sec=0, nanosec=20000000}, liveliness=AUTOMATIC}}, dds-subscriber={topic=FusedObjects, data-type=ObjectList, dds-qos={reliability=RELIABLE, durability=VOLATILE, history=KEEP_LAST, history-depth=1, liveliness=AUTOMATIC}}
  dds domain participant config Domain2_ControlDomain: domain-id=2
    dds domain participant PlanningECU:
      qos-profile=control_realtime
      dds-publisher={topic=FusedObjects, data-type=ObjectList, dds-qos={reliability=RELIABLE, durability=TRANSIENT_LOCAL, history=KEEP_LAST, history-depth=10, liveliness=AUTOMATIC}}
      dds-subscriber={topic=CameraObjectDetection, data-type=ObjectDetectionData, dds-qos={reliability=RELIABLE, durability=VOLATILE, history=KEEP_LAST, history-depth=1, liveliness=AUTOMATIC}}
      dds-subscriber={topic=RadarData, data-type=RadarPointCloud, dds-qos={reliability=RELIABLE, durability=VOLATILE, history=KEEP_LAST, history-depth=1, liveliness=AUTOMATIC}}
  dds qos profile sensor_high_reliability: dds-qos={reliability=RELIABLE, durability=VOLATILE, history=KEEP_LAST, history-depth=1, deadline={sec=0, nanosec=33000000}, liveliness=AUTOMATIC}
  dds qos profile control_realtime: dds-qos={reliability=RELIABLE, durability=TRANSIENT_LOCAL, history=KEEP_LAST, history-depth=10, liveliness=AUTOMATIC}
  dds qos profile best_effort_sensor: dds-qos={reliability=BEST_EFFORT, durability=VOLATILE, history=KEEP_LAST, history-depth=1, liveliness=AUTOMATIC}
  4 x dds topic config:
    CameraObjectDetection: data-type=ObjectDetectionData, dds-qos={reliability=RELIABLE, durability=VOLATILE, history=KEEP_LAST, history-depth=1, deadline={sec=0, nanosec=33000000}, liveliness=AUTOMATIC}  # Object detection results from camera
    CameraImage: data-type=ImageData, dds-qos={reliability=RELIABLE, durability=VOLATILE, history=KEEP_LAST, history-depth=1, liveliness=AUTOMATIC}  # Raw camera image data
    RadarData: data-type=RadarPointCloud, dds-qos={reliability=RELIABLE, durability=VOLATILE, history=KEEP_LAST, history-depth=1, liveliness=AUTOMATIC}  # Radar point cloud data
    FusedObjects: data-type=ObjectList, dds-qos={reliability=RELIABLE, durability=VOLATILE, history=KEEP_LAST, history-depth=1, liveliness=AUTOMATIC}  # Fused object list from sensor fusion
  dds transport config TransportConfig: kind=UDP, interface=eth0, multicast-address=239.255.0.1, port-base=7400
  dds tsn config TSNConfig: enabled=true
    tsn stream CameraStream: priority=7, bandwidth=10000000, max-latency=100000
    tsn stream ControlStream: priority=6, bandwidth=1000000, max-latency=50000
  dds security config SecurityConfig: enabled=false
