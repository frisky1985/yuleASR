AUTOSAR XML (schema 4-2-2)
package /ECUC
  module config Os: implementation-config-variant=VARIANT-PRE-COMPILE
    OsCounter_SystemCounter (OsCounter): OsCounterMaxAllowedValue=4294967295, OsCounterMinCycle=1, OsCounterTicksPerBase=1000, OsCounterType=HARDWARE
    OsTask_InitTask (OsTask): OsTaskActivation=1, OsTaskAutostart=true, OsTaskPriority=1, OsTaskSchedule=FULL
      OsTaskAutostart (OsTaskAutostartRef): OsTaskAppModeRef=OsAppMode_OS
    OsTask_IdleTask (OsTask): OsTaskPriority=0
  module config Com: implementation-config-variant=VARIANT-PRE-COMPILE
    ComConfig: ComMaxIPduCnt=32, ComDevErrorDetect=true, ComVersionInfoApi=true
      ComIPdu_EngineData (ComIPdu): ComIPduHandleId=0, ComIPduDirection=SEND, ComIPduSignalProcessing=DEFERRED
