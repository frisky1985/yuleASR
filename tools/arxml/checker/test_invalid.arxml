AUTOSAR XML (schema 4.0)
ar-package:
  app type TestType: type=Type
