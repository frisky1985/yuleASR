AUTOSAR XML (schema 4.0)
package /TestPackage
  app type MyUint8: category=VALUE, compu {identical}
  unit Celsius
  unit Fahrenheit
