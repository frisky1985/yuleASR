AUTOSAR XML (schema 4-0-3)
10 x ecuc value:
  Mcu
    Mcu (): McuDevErrorDetect=TRUE, McuVersionInfoApi=TRUE, McuCoreCount=4, McuSystemFrequencyHz=800000000, McuBusFrequencyHz=200000000
  Can
    Can (): CanDevErrorDetect=TRUE, CanControllerCount=2, CanHohCount=8, CanBaudrate=500000
  CanIf
    CanIf (): CanIfDevErrorDetect=TRUE, CanIfNumberOfCanCtrlrs=2, CanIfNumberOfRxLBoxes=16, CanIfNumberOfTxLBoxes=16
  Com
    Com (): ComDevErrorDetect=TRUE, ComSignalGroupSupport=TRUE, ComNumberOfSignalGroups=10
  PduR
    PduR (): PduRDevErrorDetect=TRUE, PduRZeroCostOperation=FALSE, PduRNumberOfRoutingPaths=32
  NvM
    NvM (): NvMDevErrorDetect=TRUE, NvMNumberOfBlocks=64, NvMMaxNumOfWriteRetries=3
  Dcm
    Dcm (): DcmDevErrorDetect=TRUE, DcmNumberOfDspSessions=2, DcmNumberOfDid=128
  Dem
    Dem (): DemDevErrorDetect=TRUE, DemNumberOfDtc=256, DemMaxNumberOfFreezeFrameRecords=10
  EcuM
    EcuM (): EcuMDevErrorDetect=TRUE, EcuMNumberOfStates=8, EcuMNumberOfWakeupSources=4
  BswM
    BswM (): BswMDevErrorDetect=TRUE, BswMNumberOfRules=20
